#include "hal_data.h"

// Function Prototypes
FSP_CPP_HEADER
void R_BSP_WarmStart(bsp_warm_start_event_t event);
FSP_CPP_FOOTER

void app_main(void);

/*******************************************************************************************************************//**
 * @brief The main entry point for the application.
 *
 * This function is generated by the RA Configuration editor and is used to generate threads if an RTOS is used.
 * If no RTOS is used, this function is called by main().
 **********************************************************************************************************************/
void hal_entry(void)
{
    /* Infinite loop for the main application logic */
    while(1)
    {
        app_main(); // Call the main application function
    }

#if BSP_TZ_SECURE_BUILD
    /* Enter non-secure code */
    R_BSP_NonSecureEnter();
#endif
}

/*******************************************************************************************************************//**
 * @brief Handles the warm start events during the startup process.
 *
 * This function is called at various points during the startup process.
 * It uses the event that is called right before main() to set up the pins.
 *
 * @param[in]  event    The point in the start-up process where the code is currently at.
 **********************************************************************************************************************/
void R_BSP_WarmStart(bsp_warm_start_event_t event)
{
    if (BSP_WARM_START_RESET == event)
    {
#if BSP_FEATURE_FLASH_LP_VERSION != 0

        /* Enable reading from data flash. */
        R_FACI_LP->DFLCTL = 1U;

        /* Normally, you would need to wait tDSTOP(6us) for data flash recovery.
           Placing the enable here, before clock and C runtime initialization,
           should negate the need for a delay since the initialization will typically take more than 6us. */
#endif
    }

    if (BSP_WARM_START_POST_C == event)
    {
        /* C runtime environment and system clocks are set up. */

        /* Configure pins. */
        R_IOPORT_Open(&IOPORT_CFG_CTRL, &IOPORT_CFG_NAME);

#if BSP_CFG_SDRAM_ENABLED

        /* Setup SDRAM and initialize it. Must configure pins first. */
        R_BSP_SdramInit(true);
#endif
    }
}

#if BSP_TZ_SECURE_BUILD

FSP_CPP_HEADER
BSP_CMSE_NONSECURE_ENTRY void template_nonsecure_callable ();

/*
 * TrustZone Secure Projects require at least one non-secure callable function
 * in order to build. This function serves as a template and can be removed if not required.
 */
BSP_CMSE_NONSECURE_ENTRY void template_nonsecure_callable ()
{
    // Non-secure callable function template
}
FSP_CPP_FOOTER

#endif
